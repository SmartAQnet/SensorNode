/**
 * \file display.h
 *
 * \brief Create logs images & QR
 *
 * This file is used to create ICON images and creating QR-code for OLED display of size 64x128.
 * 
 * \date 3.1.2020
 */

#include <U8g2lib.h>
#include <U8x8lib.h>
#include <qrcode.h>

///version 3 code with double sized code and starting at y0 = 2 is good
const int QRcode_Version = 3;   //  set the version (range 1->40)
///version 3 with ECC_LOW gives 53 "bytes".
const int QRcode_ECC = 0;       //  set the Error Correction level (range 0-3) or symbolic (ECC_LOW, ECC_MEDIUM, ECC_QUARTILE and ECC_HIGH)
///define for double sized pixel QR code
#define _QR_doubleSize    

//TECO Icon
/// TECO Icon bits of size 64x128
const uint8_t PROGMEM teco[] = {  
   0xff, 0xff, 0xff, 0xff, 0xff, 0xff, 0xff, 0xff, 0xff, 0xff, 0xff, 0xff,
   0xff, 0xff, 0xff, 0xff, 0xff, 0xff, 0xff, 0xff, 0xff, 0xff, 0xff, 0xff,
   0xff, 0xff, 0xff, 0xff, 0xff, 0xff, 0xff, 0xff, 0xff, 0xff, 0xff, 0xff,
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   0xff, 0xff, 0xff, 0xff };



// KIT Icon 
/// KIT Icon bits of size 64x128
const uint8_t PROGMEM kit[] = {
   0xff, 0xff, 0xff, 0xff, 0xff, 0xff, 0xff, 0xff, 0xff, 0xff, 0xff, 0xff,
   0xff, 0xff, 0xff, 0xff, 0xff, 0xff, 0xff, 0xff, 0xff, 0xff, 0xff, 0xff,
   0xff, 0xff, 0xff, 0xff, 0xff, 0xff, 0xff, 0xff, 0xff, 0xff, 0xff, 0xff,
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   0xff, 0xff, 0xff, 0xff };
   
/// Create the QR code variable
QRCode qrcode;                  

/// U8G2_SSD1306_128X64_NONAME_F_HW_I2C u8g2(U8G2_R0, /* reset=*/ 16, /* clock=*/ 15, /* data=*/ 4);
extern U8G2_SSD1306_128X64_NONAME_F_HW_I2C u8g2;


/**************************************************************************/
/*!
    @brief  Highlight the OLED pixels
*/
/**************************************************************************/
void setPixelsHigh()
{
  for (uint8_t y = 0; y < 63; y++) 
  {
    for (uint8_t x = 0; x < 127; x++) 
    {
      u8g2.setDrawColor(1);       //change to 0 to make QR code with black background
      u8g2.drawPixel(x, y);
    }
  }
}

/**************************************************************************/
/*!
    @brief  Display the created QR code at given x,y coordinate
    @param xinit int value for x coordinate
    @param yinit int value for y coordinate
*/
/**************************************************************************/
void displayQRCode(unsigned int xinit, unsigned int yinit)
{
  uint8_t x0 = xinit;
  uint8_t y0 =  yinit;   //

  //display QRcode
  for (uint8_t y = 0; y < qrcode.size; y++) 
  {
    for (uint8_t x = 0; x < qrcode.size; x++) 
    {

      if (qrcode_getModule(&qrcode, x, y) == 0)      //change to == 1 to make QR code with black background
      {
        u8g2.setDrawColor(1);

        #ifdef  _QR_doubleSize
          //uncomment to double the QRcode. Comment to display normal code size
          u8g2.drawPixel(x0 + 2 * x,     y0 + 2 * y);
          u8g2.drawPixel(x0 + 2 * x + 1, y0 + 2 * y);
          u8g2.drawPixel(x0 + 2 * x,     y0 + 2 * y + 1);
          u8g2.drawPixel(x0 + 2 * x + 1, y0 + 2 * y + 1);
        #else
          //uncomment to display code in normal size.  Comment to double the QRcode
          u8g2.drawPixel(x0 + x, y0 + y);
        #endif
      } 
      else 
      {
        u8g2.setDrawColor(0);
        #ifdef  _QR_doubleSize
          //uncomment to double the QRcode. Comment to display normal code size
          u8g2.drawPixel(x0 + 2 * x,     y0 + 2 * y);
          u8g2.drawPixel(x0 + 2 * x + 1, y0 + 2 * y);
          u8g2.drawPixel(x0 + 2 * x,     y0 + 2 * y + 1);
          u8g2.drawPixel(x0 + 2 * x + 1, y0 + 2 * y + 1);
        #else
          //uncomment to display code in normal size.  Comment to double the QRcode
          u8g2.drawPixel(x0 + x, y0 + y);
        #endif
      }
    }
  }
  u8g2.sendBuffer();
  u8g2.setDrawColor(1);//set to black backgroung again  
}

/**************************************************************************/
/*!
    @brief  Generate the QR code
    @param xinit int value for x coordinate
    @param yinit int value for y coordinate
    @param txt String value for generating the QR Code
*/
/**************************************************************************/
void generateQRCode(unsigned int xinit, unsigned int yinit, const char *txt)
{
  // Allocate memory to store the QR code. memory size depends on version number
  uint8_t qrcodeData[qrcode_getBufferSize(QRcode_Version)];
  
  //configure the text string to code. https://github.com/ArkEcosystem/AIPs/blob/master/AIPS/aip-13.md#simpler-syntax
  qrcode_initText(&qrcode, qrcodeData, QRcode_Version, QRcode_ECC, txt);     //bitcoin address
  
  //Highlight all the pixels
  setPixelsHigh();
  
  //display the generated qr code
  displayQRCode(xinit, yinit);
   
}
